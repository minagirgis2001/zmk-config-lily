## config/boards/shields/lily58/Kconfig.defconfig
```kconfig
if SHIELD_LILY58_LEFT || SHIELD_LILY58_RIGHT

if ZMK_DISPLAY

config ZMK_WIDGET_BONGO_CAT
    bool "Enable bongo cat widget"
    select LV_USE_CANVAS
    select LV_USE_IMG
    default n

endif # ZMK_DISPLAY

endif
```

## config/west.yml
```yaml
manifest:
  remotes:
    - name: zmkfirmware
      url-base: https://github.com/zmkfirmware
    - name: gpeye
      url-base: https://github.com/GPeye
  projects:
    - name: zmk
      remote: zmkfirmware
      revision: main
      import: app/west.yml
    - name: nice-view-mod
      remote: gpeye
      revision: main
  self:
    path: config
```
